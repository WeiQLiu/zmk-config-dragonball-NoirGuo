## Kconfig
```kconfig
config ZMK_INPUT_PROCESSOR_MOUSE_LAYER_GATE
    bool "Movement-gated temporary mouse layer input processor"
    default y if DT_HAS_ZMK_INPUT_PROCESSOR_MOUSE_LAYER_GATE_ENABLED
    depends on ZMK_POINTING
    depends on !ZMK_SPLIT || ZMK_SPLIT_ROLE_CENTRAL
    help
      Input processor that only activates a temporary layer after the
      trackball has moved a configurable distance inside a short time
      window, then deactivates it again after an idle timeout.

      Unlike zmk,input-processor-temp-layer, tiny bumps and chassis
      vibrations do not switch layers, and pressing a non-transparent
      key on the target layer restarts the idle timeout.

config ZMK_KEY_STATUS_OVERLAY
    bool "Show the last key sent to the host on the display"
    default y if ZMK_DISPLAY
    depends on ZMK_DISPLAY
    select LV_USE_LABEL
    select LV_FONT_UNSCII_8
    help
      Adds a small overlay in the free middle-right area of the dongle
      display that shows the last key press sent to the computer, for
      example A, Space, Enter, PageUp or PageDn.

      Pure modifier presses are ignored because the existing modifier
      widget already shows them.
```

## dts/bindings/input_processors/zmk,input-processor-mouse-layer-gate.yaml
```yaml
# Copyright (c) 2026 The ZMK Contributors
# SPDX-License-Identifier: MIT

description: |
  Input processor that activates a temporary layer only after enough
  trackball movement, and keeps it active while the trackball moves or a
  non-transparent key on that layer is held.

  param1 = target layer index
  param2 = idle timeout in milliseconds

compatible: "zmk,input-processor-mouse-layer-gate"

include: ip_two_param.yaml

properties:
  activation-threshold:
    type: int
    required: false
    default: 30
    description: |
      Cumulative |dx| + |dy| (in input counts, after any earlier scaler)
      that must be reached before the layer is activated.

  activation-window-ms:
    type: int
    required: false
    default: 300
    description: |
      Time window over which the movement is accumulated. If no movement
      arrives for this long, the accumulator is reset. This prevents very
      slow drift from eventually crossing the threshold.
```
